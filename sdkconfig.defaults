## sdkconfig.defaults
```kconfig
# C-R2 NETWORK BENCH ONLY: TAS PDN and charger enable are held LOW.
CONFIG_IDF_TARGET="esp32s3"
CONFIG_AUDIO_BOARD_CUSTOM=y
CONFIG_DAC_CR2_BENCH=y
CONFIG_MASTER_I2S_MCLK_PIN=-1
CONFIG_MASTER_I2S_BCK_PIN=17
CONFIG_MASTER_I2S_LRCK_PIN=15
CONFIG_MASTER_I2S_DATAOUT_PIN=16
CONFIG_DAC_I2C_SDA=8
CONFIG_DAC_I2C_SCL=9
CONFIG_DAC_I2C_ADDR=0x4c
CONFIG_USE_DSP_PROCESSOR=n
CONFIG_USE_SAMPLE_INSERTION=y
CONFIG_SNAPCLIENT_USE_TIMEFILTER=y
CONFIG_SNAPCLIENT_NAME="speaker-cr2-bench"
CONFIG_SNAPSERVER_USE_MDNS=n
CONFIG_SNAPSERVER_HOST="snapserver.local"
CONFIG_SNAPSERVER_PORT=1704
CONFIG_ENABLE_WIFI_PROVISIONING=y
CONFIG_WIFI_AUTH_WPA2_PSK=y
CONFIG_WIFI_MAXIMUM_RETRY=0
CONFIG_SNAPCLIENT_USE_INTERNAL_ETHERNET=n
CONFIG_SNAPCLIENT_USE_SPI_ETHERNET=n
CONFIG_ESP32_UDP_LOGGER_ENABLED=n
CONFIG_ESP_CONSOLE_USB_SERIAL_JTAG=y
CONFIG_ESP_CONSOLE_SECONDARY_NONE=y
CONFIG_USJ_NO_AUTO_LS_ON_CONNECTION=y
CONFIG_ESPTOOLPY_FLASHMODE_DIO=y
CONFIG_ESPTOOLPY_FLASHFREQ_80M=y
CONFIG_ESPTOOLPY_FLASHSIZE_8MB=y
CONFIG_PARTITION_TABLE_CUSTOM=y
CONFIG_PARTITION_TABLE_CUSTOM_FILENAME="partitions.csv"
CONFIG_BOOTLOADER_APP_ROLLBACK_ENABLE=n
CONFIG_COMPILER_OPTIMIZATION_PERF=y
CONFIG_ESP_DEFAULT_CPU_FREQ_MHZ_240=y
CONFIG_ESP_MAIN_TASK_STACK_SIZE=8192
CONFIG_FREERTOS_HZ=1000
CONFIG_FREERTOS_IDLE_TASK_STACKSIZE=1536
CONFIG_PM_ENABLE=n
CONFIG_FREERTOS_USE_TICKLESS_IDLE=n
CONFIG_SPIRAM=y
CONFIG_SPIRAM_MODE_OCT=y
CONFIG_SPIRAM_SPEED_80M=y
CONFIG_SPIRAM_MEMTEST=y
CONFIG_SPIRAM_BOOT_INIT=y
CONFIG_SPIRAM_USE_MALLOC=y
CONFIG_SPIRAM_IGNORE_NOTFOUND=n
CONFIG_SPIRAM_MALLOC_RESERVE_INTERNAL=65536
CONFIG_LOG_DEFAULT_LEVEL_INFO=y
CONFIG_LOG_MAXIMUM_LEVEL_INFO=y
CONFIG_LOG_COLORS=n
CONFIG_LWIP_MAX_SOCKETS=12
CONFIG_MDNS_TASK_STACK_SIZE=4096

CONFIG_LWIP_TCP_WND_DEFAULT=32768
CONFIG_LWIP_TCP_RECVMBOX_SIZE=32
```
